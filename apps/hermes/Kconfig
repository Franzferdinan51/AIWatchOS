## components/aiwatchos_net/Kconfig
```kconfig
menu "AIWatchOS Network"

config AIWATCHOS_NET_ENABLE
    bool "Enable WiFi + Muse link"
    default y
    help
        Brings up the shared network component (WiFi STA, SNTP) and the
        Muse transport (WSS + Noise XX to the Hatch VM). When disabled,
        or when no credentials are configured, the watch behaves exactly
        as before: voice turns collect in the Muse outbox offline.

config AIWATCHOS_NET_WIFI_SSID
    string "WiFi SSID (build-time default)"
    default ""
    help
        Default network to join. An NVS value saved through the settings
        seam (namespace "aiwnet", key "ssid") overrides this at runtime.

config AIWATCHOS_NET_WIFI_PASSWORD
    string "WiFi password (build-time default)"
    default ""

config AIWATCHOS_NET_HATCH_TOKEN
    string "Hatch device token (build-time default)"
    default ""
    help
        Account device token used against https://api.muse.ai/fetch_vms
        to resolve the VM and its per-VM credential. Leave empty when a
        VM token is configured directly instead.

config AIWATCHOS_NET_HATCH_VM_TOKEN
    string "VM token directly (skips the account API)"
    default ""
    help
        The per-VM bearer token for the /v1/noise connection itself.
        When set (with a VM id and host), the account API is not called.

config AIWATCHOS_NET_HATCH_VM
    string "VM id (empty: the account's default VM)"
    default ""

config AIWATCHOS_NET_HATCH_HOST
    string "VM host override (empty: derive from the VM's wss URL)"
    default ""
    help
        Host to open the TLS connection to. When empty, the edge
        host (AIWATCHOS_NET_HATCH_DOMAIN) is used and the VM is
        selected by the ?vm_id= upgrade query — the model every
        official SDK client uses. Set this only for a private edge.

config AIWATCHOS_NET_HATCH_DOMAIN
    string "Muse edge host (VMs are selected by ?vm_id=)"
    default "hatch.metaaivm.com"

config AIWATCHOS_NET_SNTP_SERVER
    string "SNTP server"
    default "pool.ntp.org"

config AIWATCHOS_NET_TTS_URL
    string "TTS speech endpoint (OpenAI-shaped /v1/audio/speech)"
    default "https://openrouter.ai/api/v1/audio/speech"
    help
        Full URL of the cloud text-to-speech endpoint for spoken Muse
        replies (M10). The default is the companion app's OpenRouter
        endpoint; any OpenAI-shaped speech API works. An NVS value
        (namespace "aiwnet", key "ttsurl") or the setup string
        overrides this at runtime.

config AIWATCHOS_NET_TTS_KEY
    string "TTS API key (build-time default)"
    default ""
    help
        Bearer key for the TTS endpoint. Leave empty in source: paste
        it at flash time or provision it via NVS ("ttskey") / the
        setup string. Empty = spoken replies off, text unaffected.
        The key is never logged and never rendered.

config AIWATCHOS_NET_TTS_MODEL
    string "TTS model id"
    default "fish-audio/s2.1-pro-free:free"
    help
        Model id sent in the speech request body. Default matches the
        companion app's OpenRouter default.

config AIWATCHOS_NET_TTS_VOICE
    string "TTS voice id (empty: provider default)"
    default ""

config AIWATCHOS_NET_TTS_SPEAK
    bool "Speak Muse replies by default"
    default n
    help
        Initial value of the OS Settings "Speak replies" toggle (the
        companion's cloud TTS is opt-in too). The runtime toggle,
        persisted to NVS ("ttsspeak"), wins once touched.

endmenu
```

## components/aiwatchos_os/Kconfig
```kconfig
menu "AIWatchOS OS"

config AIWATCHOS_DISPLAY_SLEEP_TIMEOUT_S
    int "Display inactivity sleep timeout (seconds)"
    default 30
    range 0 3600
    help
        Seconds without touch or button input before the CO5300 panel is
        put to sleep (display off + SLPIN) and the main loop pauses all
        rendering. Wake is on touch, BOOT, or PWR press; the touch that
        wakes the panel is swallowed so it cannot fire the UI element
        under it. Set to 0 to disable the inactivity timeout (the PWR
        short-press sleep/wake toggle still works).

config AIWATCHOS_TZ_OFFSET_MIN
    int "Displayed time-of-day offset from UTC (minutes)"
    default -240
    range -720 840
    help
        Offset applied ONLY when deriving the displayed time-of-day
        (status bar + clock face) from the UTC epoch. Default -240 =
        EDT (UTC-4). The epoch itself stays true UTC everywhere else:
        the PCF85063 RTC, SNTP discipline and all protocols keep UTC.

endmenu
```

## components/aiwatchos_weather/Kconfig
```kconfig
menu "AIWatchOS Weather"

config AIWATCHOS_WEATHER_ENABLE
    bool "Enable Open-Meteo weather fetch"
    default y
    help
        Starts the weather service task: current conditions for the
        configured location are fetched from Open-Meteo (no API key)
        over HTTPS and shown by the weather app. With WiFi unconfigured
        the service stays idle and the app shows its NO DATA YET state.

config AIWATCHOS_WEATHER_LAT
    string "Latitude (decimal degrees)"
    default "39.864"
    help
        Default location is Huber Heights, Ohio. Any decimal latitude,
        e.g. "39.864". Used verbatim in the Open-Meteo query.

config AIWATCHOS_WEATHER_LON
    string "Longitude (decimal degrees)"
    default "-84.132"
    help
        Any decimal longitude, e.g. "-84.132" (west is negative).

config AIWATCHOS_WEATHER_REFRESH_MIN
    int "Refresh interval (minutes)"
    range 5 240
    default 30
    help
        How often the service refetches while WiFi is configured. The
        weather app also requests a refresh when opened with stale (or
        no) data, and marks readings older than one interval as STALE.

endmenu
```

## main/Kconfig.projbuild
```kconfig
menu "AIWatchOS"

config AIWATCHOS_MDB_ENABLE
    bool "MDB — Muse Developer Bridge (debug console over USB serial)"
    default y
    help
        The Muse Developer Bridge: a line-based debug console on the
        USB serial port (mdb screenshot / health / logs / touch /
        panic, plus ADB-style input injection — tap, swipe, press,
        goto, wake, sleep, reboot). Protocol: docs/mdb.md.

        ON by default for the hardware bring-up builds. Turn OFF for
        any build that leaves the bench: the console accepts input
        injection from anything that can open the serial port.

endmenu
```
